## configs/radxa-cubie-a7z_defconfig
```kconfig
CONFIG_ARM=y
CONFIG_ARCH_SUNXI=y
CONFIG_HAS_CUSTOM_SYS_INIT_SP_ADDR=y
CONFIG_CUSTOM_SYS_INIT_SP_ADDR=0x4F000000
CONFIG_DEFAULT_DEVICE_TREE="sun60i-a733-cubie-a7z"
CONFIG_SPL=y
CONFIG_SPL_DM=y
CONFIG_SPL_OF_CONTROL=y
# CONFIG_SPL_DM_I2C is not set
# CONFIG_SPL_DM_PMIC is not set
CONFIG_SPL_MAX_SIZE=0x49000
CONFIG_MACH_SUN60I_A733=y
CONFIG_MMC_SUNXI_SLOT_EXTRA=2
# CONFIG_VIDEO_SUNXI is not set
CONFIG_RADXA_UNIFIED_IMAGE=y
# CONFIG_SYS_MALLOC_CLEAR_ON_INIT is not set
CONFIG_SPL_LOAD_FIT_ADDRESS=0x47a00000
CONFIG_SPL_SPI_SUNXI=y
CONFIG_SPL_UFS_SUPPORT=y
CONFIG_SPL_UFS_RAW_U_BOOT_SECTOR=0x14c
# CONFIG_SPL_DM_SERIAL is not set
CONFIG_BOOTDELAY=3
CONFIG_AHCI=y
CONFIG_FDT_FIXUP_PARTITIONS=y
CONFIG_SPL_RAM_DEVICE=y
CONFIG_CMD_DFU=y
CONFIG_CMD_I2C=y
CONFIG_CMD_MTD=y
CONFIG_CMD_UFS=y
CONFIG_CMD_SF_TEST=y
CONFIG_CMD_SPI=y
CONFIG_NET_RANDOM_ETHADDR=y
CONFIG_ADC=y
CONFIG_SUNXI_GPADC=y
CONFIG_SYS_I2C_MVTWSI=y
CONFIG_MISC=y
CONFIG_NVMEM=y
CONFIG_I2C_EEPROM=y
CONFIG_RADXA_ID_EEPROM=y
CONFIG_SYS_I2C_EEPROM_ADDR=0x50
CONFIG_SYS_I2C_EEPROM_ADDR_OVERFLOW=0x7
CONFIG_SUPPORT_EMMC_BOOT=y
CONFIG_MTD=y
CONFIG_MTD_BLOCK=y
CONFIG_SPI_FLASH_SOFT_RESET=y
CONFIG_SPI_FLASH_SOFT_RESET_ON_BOOT=y
CONFIG_SPI_FLASH_MACRONIX=y
CONFIG_SPI_FLASH_SPANSION=y
CONFIG_SPI_FLASH_STMICRO=y
CONFIG_SPI_FLASH_SST=y
CONFIG_SPI_FLASH_WINBOND=y
CONFIG_SPI_FLASH_XMC=y
CONFIG_SPI_FLASH_DATAFLASH=y
CONFIG_SPI_FLASH_MTD=y
CONFIG_DM_MDIO=y
CONFIG_DM_ETH_PHY=y
CONFIG_DWC_ETH_QOS=y
CONFIG_DWC_ETH_QOS_SUNXI=y
CONFIG_RGMII=y
CONFIG_RMII=y
CONFIG_REGULATOR_AXP=y
CONFIG_USB_EHCI_HCD=y
CONFIG_USB_OHCI_HCD=y
CONFIG_USB_MUSB_GADGET=y
CONFIG_USB_ETH_CDC=y
CONFIG_SPL_STACK_R_MALLOC_SIMPLE_LEN=0x140000
CONFIG_PCI=y
CONFIG_NVME_PCI=y
CONFIG_PCIE_SUNXI=y
CONFIG_AW_CADENCE_COMBOPHY=y
CONFIG_REGULATOR_AXP=y
CONFIG_CMD_PCI=y
CONFIG_SCSI=y
CONFIG_SCSI_AHCI=y
CONFIG_SPI=y
CONFIG_UFS=y
CONFIG_UFS_SUNXI=y
```
